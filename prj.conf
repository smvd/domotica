## CMakeLists.txt
```
cmake_minimum_required(VERSION 3.20.0)

find_package(Zephyr REQUIRED HINTS $ENV{ZEPHYR_BASE})
project(project)

target_sources(app PRIVATE src/main.c src/shell.c src/uart.c src/usb.c src/coap.c src/gpio.c src/hwid.c src/command.c)
```

## Kconfig
```
mainmenu "Mesh Network Configuration"

config MESH_ROUTER_NODE
    bool "Enable mesh router functionality"
    default n
    help
      Enable this option to make this node act as a mesh router.

source "Kconfig.zephyr"
```

## prj.conf
```kconfig
CONFIG_PRINTK=y
CONFIG_LOG=y
CONFIG_LOG_DEFAULT_LEVEL=2

CONFIG_NEWLIB_LIBC=y
CONFIG_NEWLIB_LIBC_FLOAT_PRINTF=y

CONFIG_CONSOLE=y
CONFIG_UART_CONSOLE=y

CONFIG_USB_DEVICE_STACK_NEXT=y
CONFIG_STDOUT_CONSOLE=y
CONFIG_SERIAL=y
CONFIG_UART_LINE_CTRL=y
CONFIG_USBD_CDC_ACM_CLASS=y
CONFIG_CDC_ACM_SERIAL_INITIALIZE_AT_BOOT=n
CONFIG_USBD_LOG_LEVEL_ERR=y
CONFIG_UDC_DRIVER_LOG_LEVEL_ERR=y
CONFIG_USBD_CDC_ACM_LOG_LEVEL_OFF=y

CONFIG_COAP=y
CONFIG_OPENTHREAD_COAP=y
CONFIG_NETWORKING=y
CONFIG_NET_L2_OPENTHREAD=y

CONFIG_MAIN_STACK_SIZE=4096
CONFIG_IDLE_STACK_SIZE=1024
CONFIG_SYSTEM_WORKQUEUE_STACK_SIZE=4096
CONFIG_NET_TX_STACK_SIZE=2048
CONFIG_NET_RX_STACK_SIZE=2048

CONFIG_OPENTHREAD_PANID=4660
CONFIG_OPENTHREAD_XPANID="11:11:11:11:22:22:22:22"
CONFIG_OPENTHREAD_NETWORKKEY="00:11:22:33:44:55:66:77:88:99:aa:bb:cc:dd:ee:ff"
CONFIG_OPENTHREAD_CHANNEL=15
CONFIG_OPENTHREAD_NETWORK_NAME="COAP_OpenThread"

CONFIG_HWINFO_NRF=y
```

## src/main.c
```c
#include "main.h"

LOG_MODULE_REGISTER(CORE, LOG_LEVEL_INF);

void main() {
	LOG_INF("Starting main");

    uint8_t errors = 0;

    errors += SHELL_Init();
    errors += HWID_Init();
    errors += COAP_Init();
    errors += GPIO_Init();
    errors += CMD_Init();

    if (errors != 0) {
        GPIO_SetStatus(STATE_ERROR);
    }

    while (1) {
        SHELL_HandleCommand();
        k_msleep(5);
    }
}
```

## src/coap.c
```c
#include "coap.h"

LOG_MODULE_REGISTER(COAP, LOG_LEVEL_INF);

otInstance * COAP_openThread;
uint8_t COAP_buffer[COAP_BUFFER_LIMIT];
size_t COAP_bufferLength;

uint8_t COAP_Init() {
    COAP_openThread = openthread_get_default_instance();
    if (!COAP_openThread) {
        LOG_ERR("Failed to get openthread instance");
        return 1;
    }

    otCoapSetDefaultHandler(COAP_openThread, COAP_DefaultHandler, NULL);

    if (otCoapStart(COAP_openThread, OT_DEFAULT_COAP_PORT) != OT_ERROR_NONE) {
        LOG_ERR("Failed to start CoAP");
        return 1;
    }

    LOG_INF("CoAP Server ready");

    return 0;
}

void COAP_DefaultHandler(void * context, otMessage * message, const otMessageInfo * messageInfo) {
    LOG_WRN("Received CoAP message that does not match any handler");
}

uint8_t COAP_SendRequest(const char * addr, const char * uri, otCoapCode code, uint8_t * buffer, size_t bufferLength) {
	otMessageInfo messageInfo;
    memset(&messageInfo, 0, sizeof(messageInfo));
	otIp6AddressFromString(addr, &messageInfo.mPeerAddr);
	messageInfo.mPeerPort = OT_DEFAULT_COAP_PORT;

    otMessage * message;
    message = otCoapNewMessage(COAP_openThread, NULL);
    if (!message) {
        LOG_ERR("Failed to create CoAP message");
        otMessageFree(message);
        return 1;
    }

	otCoapMessageInit(message, OT_COAP_TYPE_NON_CONFIRMABLE, code);

    otError err = otCoapMessageAppendUriPathOptions(message, uri);
	if (err != OT_ERROR_NONE) {
		LOG_ERR("Failed to append URI to message");
		otMessageFree(message);
        return 1;
	}

    err = otCoapMessageSetPayloadMarker(message);
	if (err != OT_ERROR_NONE) {
		LOG_ERR("Failed to set payload marker for message");
		otMessageFree(message);
        return 1;
	}

	err = otMessageAppend(message, buffer, bufferLength);
	if (err != OT_ERROR_NONE) {
		LOG_ERR("Failed to append buffer to message");
		otMessageFree(message);
		return 1;
	}

	err = otCoapSendRequest(COAP_openThread, message, &messageInfo, NULL, NULL);
	if (err != OT_ERROR_NONE) {
		LOG_ERR("Failed to send request");
		otMessageFree(message);
		return 1;
	}

    return 0;
}

uint8_t COAP_RequestHandler(void * ctx, otMessage * message, const otMessageInfo * messageInfo, COAP_Function_t putFunction, COAP_Function_t getFunction) {
    otCoapCode messageCode = otCoapMessageGetCode(message);
    otCoapType messageType = otCoapMessageGetType(message);

    if (messageType != OT_COAP_TYPE_NON_CONFIRMABLE) {
        return 1;
    }

    if (messageCode == OT_COAP_CODE_PUT && putFunction != NULL) {
		COAP_bufferLength = otMessageGetLength(message) - otMessageGetOffset(message);
		otMessageRead(message, otMessageGetOffset(message), COAP_buffer, COAP_bufferLength);
		
        return putFunction(ctx, message, messageInfo);
    } else if (messageCode == OT_COAP_CODE_GET && getFunction != NULL) {
        return getFunction(ctx, message, messageInfo);
    }

    return 1;
}
```

## src/coap.h
```c
#ifndef INCLUDED_COAP
#define INCLUDED_COAP

#include <zephyr/kernel.h>
#include <zephyr/logging/log.h>
#include <stdint.h>
#include <zephyr/net/coap.h>
#include <zephyr/net/openthread.h>
#include <openthread/coap.h>

#define COAP_BUFFER_LIMIT 32

extern otInstance * COAP_openThread;
extern uint8_t COAP_buffer[COAP_BUFFER_LIMIT];
extern size_t COAP_bufferLength;

typedef uint8_t (*COAP_Function_t)(void *ctx, otMessage *message, const otMessageInfo *messageInfo);

uint8_t COAP_Init();
void COAP_DefaultHandler(void * context, otMessage * message, const otMessageInfo * messageInfo);
uint8_t COAP_SendRequest(const char * addr, const char * uri, otCoapCode code, uint8_t * buffer, size_t bufferLength);
uint8_t COAP_RequestHandler(void * ctx, otMessage * message, const otMessageInfo * messageInfo, COAP_Function_t putFunction, COAP_Function_t getFunction);

#endif
```

## src/command.c
```c
#include "command.h"

LOG_MODULE_REGISTER(CMD, LOG_LEVEL_INF);

struct CMD_Nodes CMD_nodes[CMD_NODE_COUNT];
uint8_t CMD_nodeIndex = 0;

otCoapResource CMD_rsc = {
    .mUriPath = "command",
    .mHandler = CMD_Handler,
    .mContext = NULL,
    .mNext = NULL
};

// scan, hwid
// update, hwid
// scanReturn, hwidSrc, hwidTarget
// identify, on/off

// CMD   HWID_A                                   HWID_B
// 0x00  0x11 0x11 0x11 0x11 0x11 0x11 0x11 0x11  0x22 0x22 0x22 0x22 0x22 0x22 0x22 0x22

uint8_t CMD_Init() {
    otCoapAddResource(COAP_openThread, &CMD_rsc);

    if (CMD_SubscribeMulticast(HWID_ToMulticast(HWID_id))) {
        LOG_ERR("Failed to subscribe to HWID_id");
        return 1;
    }

    if (CMD_SubscribeMulticast("ff03::1")) {
        LOG_ERR("Failed to subscribe to ff03::1");
        return 1;
    }

    LOG_INF("Commands registed and ready");
    return 0;
}

void CMD_Handler(void * ctx, otMessage * message, const otMessageInfo * messageInfo) {
    COAP_RequestHandler(ctx, message, messageInfo, CMD_PutHandler, CMD_GetHandler);
}

void CMD_SendScan() {
    CMD_nodeIndex = 1;
    CMD_nodes[0].sourceHwid = HWID_id;
    CMD_nodes[0].targetHwid = GPIO_targetHWID;
    uint8_t commandBuffer[COAP_BUFFER_LIMIT];
    CMD_Serialize(commandBuffer, COMMAND_SCAN, HWID_id, 0x0000000000000000);
    COAP_SendRequest("ff03::1", "command", OT_COAP_CODE_PUT, commandBuffer, 17);
}

void CMD_SendUpdate(uint64_t deviceToUpdate, uint64_t newTarget) {
    if (deviceToUpdate == HWID_id) {
        GPIO_targetHWID = newTarget;
        return;
    }

    uint8_t commandBuffer[COAP_BUFFER_LIMIT];
    CMD_Serialize(commandBuffer, COMMAND_UPDATE, newTarget, 0x0000000000000000);
    COAP_SendRequest(HWID_ToMulticast(deviceToUpdate), "command", OT_COAP_CODE_PUT, commandBuffer, 17);
}

void CMD_SendIdentify(uint64_t hwid, uint8_t state) {
    if (hwid == HWID_id) {
        if (state == 1) {
            GPIO_SetStatus(STATE_IDENTIFY);
        } else {
            GPIO_SetStatusDefault();
        }
        return;
    }

    uint8_t commandBuffer[COAP_BUFFER_LIMIT];
    CMD_Serialize(commandBuffer, COMMAND_IDENTIFY, (state == 1) ? (0xFFFFFFFFFFFFFFFF) : (0x0000000000000000), 0x0000000000000000);
    COAP_SendRequest(HWID_ToMulticast(hwid), "command", OT_COAP_CODE_PUT, commandBuffer, 17);
}

void CMD_Serialize(uint8_t * commandBuffer, uint8_t command, uint64_t hwidA, uint64_t hwidB) {
    commandBuffer[0] = command;
    memcpy(commandBuffer + 1, &hwidA, 8);
    memcpy(commandBuffer + 9, &hwidB, 8);
}

struct CMD_Command CMD_Deserialize() {
    struct CMD_Command command;
    command.command = COAP_buffer[0];
    memcpy(&command.hwidA, COAP_buffer + 1, 8);
    memcpy(&command.hwidB, COAP_buffer + 9, 8);

    return command;
}

uint8_t CMD_SubscribeMulticast(const char* multicastAddr) {
    otError error;
    otIp6Address addr;
    error = otIp6AddressFromString(multicastAddr, &addr);
    if (error != OT_ERROR_NONE) {
        LOG_ERR("Failed to parse multicast address: %s", multicastAddr);
        return 1;
    }
    error = otIp6SubscribeMulticastAddress(COAP_openThread, &addr);
    if (error != OT_ERROR_NONE && error != OT_ERROR_ALREADY) {
        LOG_ERR("Failed to subscribe to: %s", multicastAddr);
        return 1;
    }

    LOG_INF("Subscribed to multicast: %s", multicastAddr);
    return 0;
}

uint8_t CMD_PutHandler(void * ctx, otMessage * message, const otMessageInfo * messageInfo) {
    struct CMD_Command command = CMD_Deserialize();

    switch (command.command) {
        case COMMAND_SCAN:
            uint8_t commandBuffer[COAP_BUFFER_LIMIT];
            CMD_Serialize(commandBuffer, COMMAND_SCAN_RETURN, HWID_id, GPIO_targetHWID);
            COAP_SendRequest(HWID_ToMulticast(command.hwidA), "command", OT_COAP_CODE_PUT, commandBuffer, 17);
            break;
        case COMMAND_SCAN_RETURN:
            CMD_nodes[CMD_nodeIndex].sourceHwid = command.hwidA;
            CMD_nodes[CMD_nodeIndex].targetHwid = command.hwidB;
            CMD_nodeIndex += 1;
            break;
        case COMMAND_UPDATE:
            GPIO_targetHWID = command.hwidA;
            break;
        case COMMAND_IDENTIFY:
            if (command.hwidA == 0xFFFFFFFFFFFFFFFF) {
                GPIO_SetStatus(STATE_IDENTIFY);
            } else {
                GPIO_SetStatusDefault();
            }
            break;
    }
    
    return 0;
}

uint8_t CMD_GetHandler(void * ctx, otMessage * message, const otMessageInfo * messageInfo) {
    return 0;
}
```

## src/command.h
```c
#ifndef INCLUDE_CMD
#define INCLUDE_CMD

#include <zephyr/kernel.h>
#include <zephyr/logging/log.h>
#include <stdint.h>
#include <zephyr/net/coap.h>
#include <zephyr/net/openthread.h>
#include <openthread/coap.h>
#include <openthread/ip6.h>

#include "hwid.h"
#include "coap.h"
#include "gpio.h"

#define CMD_NODE_COUNT 8

#define COMMAND_SCAN        0x00
#define COMMAND_SCAN_RETURN 0x01
#define COMMAND_UPDATE      0x02
#define COMMAND_IDENTIFY    0x03

struct CMD_Nodes {
    uint64_t sourceHwid;
    uint64_t targetHwid;
};

struct CMD_Command {
    uint8_t command;
    uint64_t hwidA;
    uint64_t hwidB;
};

extern struct CMD_Nodes CMD_nodes[CMD_NODE_COUNT];
extern uint8_t CMD_nodeIndex;

uint8_t CMD_Init();
void CMD_Handler(void * ctx, otMessage * message, const otMessageInfo * messageInfo);
void CMD_Serialize(uint8_t * commandBuffer, uint8_t command, uint64_t hwidA, uint64_t hwidB);
struct CMD_Command CMD_Deserialize();
uint8_t CMD_PutHandler(void * ctx, otMessage * message, const otMessageInfo * messageInfo);
uint8_t CMD_GetHandler(void * ctx, otMessage * message, const otMessageInfo * messageInfo);
uint8_t CMD_SubscribeMulticast(const char * multicastAddr);
void CMD_SendScan();
void CMD_SendUpdate(uint64_t deviceToUpdate, uint64_t newTarget);
void CMD_SendIdentify(uint64_t hwid, uint8_t state);

#endif
```

## src/gpio.c
```c
#include "gpio.h"

LOG_MODULE_REGISTER(GPIO, LOG_LEVEL_INF);

enum _GPIO_STATE GPIO_state = STATE_UNKNOWN;
uint64_t GPIO_targetHWID = 0x51b317d464fcdb96;

const struct gpio_dt_spec GPIO_STATUS_LEDS[GPIO_STATUS_LED_COUNT] = {
    GPIO_DT_SPEC_GET(DT_ALIAS(led1), gpios),
    GPIO_DT_SPEC_GET(DT_ALIAS(led2), gpios),
    GPIO_DT_SPEC_GET(DT_ALIAS(led3), gpios),
};

const struct gpio_dt_spec GPIO_LED = GPIO_DT_SPEC_GET(DT_ALIAS(led0), gpios);
const struct gpio_dt_spec GPIO_BUTTON = GPIO_DT_SPEC_GET(DT_ALIAS(sw0), gpios);
struct gpio_callback GPIO_buttonCallbackData;

otCoapResource GPIO_rsc = {
    .mUriPath = "led",
    .mHandler = GPIO_Handler,
    .mContext = NULL,
    .mNext = NULL
};

uint8_t GPIO_Init() {
    for (uint8_t i = 0; i < GPIO_STATUS_LED_COUNT; i += 1) {
        if (!(gpio_is_ready_dt(&GPIO_STATUS_LEDS[i]))) {
            LOG_ERR("status led device %d not ready", i);
    		return 1;
        }

        if (gpio_pin_configure_dt(&GPIO_STATUS_LEDS[i], GPIO_OUTPUT_HIGH) < 0) {
            LOG_ERR("status led configuration for %d failed", i);
        	return 1;
        }
    }

	if (!gpio_is_ready_dt(&GPIO_LED)) {
        LOG_ERR("led device not ready");
        return 1;
	}
	
	if (gpio_pin_configure_dt(&GPIO_LED, GPIO_OUTPUT_HIGH) < 0) {
        LOG_ERR("led configuration failed");
		return 1;
	}
	
	if (!gpio_is_ready_dt(&GPIO_BUTTON)) {
        LOG_ERR("button device not ready");
        return 1;
	}

	if (gpio_pin_configure_dt(&GPIO_BUTTON, GPIO_INPUT) != 0) {
        LOG_ERR("failed to configure button");
        return 1;
	}

	if (gpio_pin_interrupt_configure_dt(&GPIO_BUTTON, GPIO_INT_EDGE_TO_ACTIVE) != 0) {
        LOG_ERR("failed to configure button interupt");
        return 1;
	}

	gpio_init_callback(&GPIO_buttonCallbackData, GPIO_ButtonCallback, BIT(GPIO_BUTTON.pin));
	gpio_add_callback_dt(&GPIO_BUTTON, &GPIO_buttonCallbackData);

	otCoapAddResource(COAP_openThread, &GPIO_rsc);

	LOG_INF("GPIO ready");

	GPIO_SetStatusDefault();

    return 0;
}

void GPIO_SetStatus(enum _GPIO_STATE state) {
    GPIO_state = state;
    switch (GPIO_state) {
        case STATE_UNKNOWN:
            gpio_pin_set_dt(&GPIO_STATUS_LEDS[0], 1);
            gpio_pin_set_dt(&GPIO_STATUS_LEDS[1], 1);
            gpio_pin_set_dt(&GPIO_STATUS_LEDS[2], 1);
            break;
        case STATE_NODE:
            gpio_pin_set_dt(&GPIO_STATUS_LEDS[0], 0);
            gpio_pin_set_dt(&GPIO_STATUS_LEDS[1], 1);
            gpio_pin_set_dt(&GPIO_STATUS_LEDS[2], 0);
            break;
        case STATE_ERROR:
            gpio_pin_set_dt(&GPIO_STATUS_LEDS[0], 1);
            gpio_pin_set_dt(&GPIO_STATUS_LEDS[1], 0);
            gpio_pin_set_dt(&GPIO_STATUS_LEDS[2], 0);
            break;
        case STATE_IDENTIFY:
            gpio_pin_set_dt(&GPIO_STATUS_LEDS[0], 0);
            gpio_pin_set_dt(&GPIO_STATUS_LEDS[1], 0);
            gpio_pin_set_dt(&GPIO_STATUS_LEDS[2], 1);
            break;
    }
}

void GPIO_SetStatusDefault() {
    GPIO_SetStatus(STATE_NODE);
}

void GPIO_ButtonCallback(const struct device * dev, struct gpio_callback * cb, uint32_t pins) {
    COAP_SendRequest(HWID_ToMulticast(GPIO_targetHWID), "led", OT_COAP_CODE_PUT, NULL, 0);
}

void GPIO_Handler(void * ctx, otMessage * message, const otMessageInfo * messageInfo) {
    COAP_RequestHandler(ctx, message, messageInfo, GPIO_PutHandler, GPIO_GetHandler);
}

uint8_t GPIO_PutHandler(void * ctx, otMessage * message, const otMessageInfo * messageInfo) {
    gpio_pin_toggle_dt(&GPIO_LED);
    return 0;
}

uint8_t GPIO_GetHandler(void * ctx, otMessage * message, const otMessageInfo * messageInfo) {
    gpio_pin_toggle_dt(&GPIO_LED);
    return 0;
}
```

## src/gpio.h
```c
#ifndef INCLUDE_GPIO
#define INCLUDE_GPIO

#include <zephyr/kernel.h>
#include <zephyr/logging/log.h>
#include <zephyr/drivers/gpio.h>
#include <stdint.h>
#include <zephyr/net/coap.h>
#include <zephyr/net/openthread.h>
#include <openthread/coap.h>

#include "hwid.h"
#include "coap.h"

#define GPIO_STATUS_LED_COUNT 3

extern uint64_t GPIO_targetHWID;
extern enum _GPIO_STATE GPIO_state;

enum _GPIO_STATE {
    STATE_UNKNOWN,
    STATE_NODE,
    STATE_ERROR,
    STATE_IDENTIFY
};

uint8_t GPIO_Init();
void GPIO_ButtonCallback(const struct device * dev, struct gpio_callback * cb, uint32_t pins);
void GPIO_Handler(void * ctx, otMessage * message, const otMessageInfo * messageInfo);
uint8_t GPIO_PutHandler(void * ctx, otMessage * message, const otMessageInfo * messageInfo);
uint8_t GPIO_GetHandler(void * ctx, otMessage * message, const otMessageInfo * messageInfo);
void GPIO_SetStatus(enum _GPIO_STATE state);
void GPIO_SetStatusDefault();

#endif
```

## src/hwid.c
```c
#include "hwid.h"

LOG_MODULE_REGISTER(HWID, LOG_LEVEL_INF);

uint64_t HWID_id = 0;

uint8_t HWID_Init() {
	size_t ret = hwinfo_get_device_id((uint8_t*)&HWID_id, sizeof(HWID_id));

	if (ret <= 0) {
	    LOG_ERR("Failed to find hardware ID");
		return 1;
	}

	LOG_INF("HWID: %016llx", HWID_id);

	return 0;
}

void HWID_ToString(uint64_t id, char * buffer) {
    const char hex_chars[] = "0123456789abcdef";

    for (int i = 15; i >= 0; i--) {
        buffer[i] = hex_chars[id & 0xF];
        id >>= 4;
    }
}

uint64_t HWID_FromString(char * buffer) {
    uint64_t value = 0;

    for (int i = 0; i < 16; i++) {
        char c = buffer[i];
        uint64_t nibble =
            (c >= '0' && c <= '9') ? (c - '0') :
            (c >= 'a' && c <= 'f') ? (c - 'a' + 0xA) : 0;

        value = (value << 4) | nibble;
    }

    return value;
}

const char * HWID_ToMulticast(uint64_t hwid)
{
    static char buf[40];

    snprintf(buf, sizeof(buf),
        "ff03::1:%04x:%04x:%04x:%04x",
        (uint16_t)(hwid >> 48),
        (uint16_t)(hwid >> 32),
        (uint16_t)(hwid >> 16),
        (uint16_t)(hwid));

    return buf;
}
```

## src/hwid.h
```c
#ifndef INCLUDED_HWID
#define INCLUDED_HWID

	#include <zephyr/drivers/hwinfo.h>
	#include <zephyr/sys/printk.h>
	#include <zephyr/logging/log.h>
	#include <zephyr/kernel.h>
	#include <stdio.h>

	#include "uart.h"

    extern uint64_t HWID_id;

	uint8_t HWID_Init();
	uint8_t HWID_MatchRouter();
	void HWID_ToString(uint64_t id, char * buffer);
	uint64_t HWID_FromString(char * buffer);
	const char * HWID_ToMulticast(uint64_t hwid);
#endif
```

## src/main.h
```c
#ifndef INCLUDED_MAIN
#define INCLUDED_MAIN

#include <zephyr/kernel.h>
#include <zephyr/logging/log.h>

#include "shell.h"
#include "coap.h"
#include "gpio.h"
#include "hwid.h"
#include "uart.h"
#include "command.h"

#endif
```

## src/shell.c
```c
#include "shell.h"

LOG_MODULE_REGISTER(SHELL, LOG_LEVEL_INF);

char * SHELL_COMMANDS[SHELL_COMMAND_COUNT] = {
    "NONE",
    "UPDATE",
    "SCAN",
    "IDENTIFY"
};

uint8_t SHELL_Init() {
    if (UART_Init()) {
        return 1;
    }

    return 0;
}

void SHELL_HandleCommand() {
    if (UART_commandReady == 1) {
        uint8_t commandID = 0;
        for (uint8_t i = 0; i < SHELL_COMMAND_COUNT; i += 1) {
            if (SHELL_Match(SHELL_COMMANDS[i], UART_commandBuffer)) {
                commandID = i;
                break;
            }
        }

        if (commandID == 0) {
            UART_Write("INVALID COMMAND\r\n", 17);
        } else if (commandID == 1) {
            uint64_t deviceToUpdate = HWID_FromString(UART_commandBuffer + 7);
            uint64_t newTarget = HWID_FromString(UART_commandBuffer + 24);
            CMD_SendUpdate(deviceToUpdate, newTarget);
        } else if (commandID == 2) {
            CMD_SendScan();
            k_msleep(1000);
            char buffer[16];
            for (uint8_t i = 0; i < CMD_nodeIndex; i += 1) {
                HWID_ToString(CMD_nodes[i].sourceHwid, buffer);
                UART_Write(buffer, 16);
                UART_Write(" ", 1);
                HWID_ToString(CMD_nodes[i].targetHwid, buffer);
                UART_Write(buffer, 16);
                UART_Write("\r\n", 2);
            }
        } else if (commandID == 3) {
            uint64_t hwid = HWID_FromString(UART_commandBuffer + 9);
            CMD_SendIdentify(hwid, *(UART_commandBuffer + 26) - '0');
        }

        UART_Write("--END--\r\n", 9);
        UART_EnableInput();
    }
}

uint8_t SHELL_Match(char * a, char * b) {
    while (*a != '\0') {
        if (*a++ != *b++) {return 0;}
    }

    return 1;
}
```

## src/shell.h
```c
#ifndef INCLUDED_SHELL
#define INCLUDED_SHELL

#include "uart.h"
#include "hwid.h"
#include "command.h"

#include <zephyr/kernel.h>
#include <zephyr/logging/log.h>
#include <stdint.h>

#define SHELL_COMMAND_COUNT 4

uint8_t SHELL_Init();
void SHELL_HandleCommand();
uint8_t SHELL_Match(char * a, char * b);

#endif
```

## src/uart.c
```c
#include "uart.h"

LOG_MODULE_REGISTER(UART, LOG_LEVEL_INF);

const struct device * UART_DEVICE = DEVICE_DT_GET_ONE(zephyr_cdc_acm_uart);

uint8_t UART_commandReady = 0;
char UART_commandBuffer[UART_BUFFER_SIZE];
size_t UART_commandBufferIndex = 0;
char UART_bufferData[UART_BUFFER_SIZE];
struct ring_buf UART_buffer;

struct usbd_context * UART_usbDevice;

uint8_t UART_Init() {
    if (!device_is_ready(UART_DEVICE)) {
    	LOG_ERR("UART device not ready");
    	return 0;
    }

    if (UART_EnableUSB()) {
    	LOG_ERR("Failed to enable USB device support");
    	return 0;
    }

    ring_buf_init(&UART_buffer, sizeof(UART_bufferData), UART_bufferData);
    
    uart_irq_callback_set(UART_DEVICE, UART_InteruptHandler);
    uart_irq_rx_enable(UART_DEVICE);

    return 0;
}

void UART_MessageCallback(struct usbd_context * const ctx, const struct usbd_msg * msg) {
    if (usbd_can_detect_vbus(ctx)) {
        if (msg->type == USBD_MSG_VBUS_READY && usbd_enable(ctx)) {
            LOG_ERR("Failed to enable device support");
        }

        if (msg->type == USBD_MSG_VBUS_REMOVED && usbd_disable(ctx)) {
            LOG_ERR("Failed to disable device support");
    	}
    }
}

uint8_t UART_EnableUSB() {
    UART_usbDevice = USB_Init(UART_MessageCallback);
    if (UART_usbDevice == NULL) {
    	LOG_ERR("Failed to initialize USB device");
    	return 1;
    }

    if (!usbd_can_detect_vbus(UART_usbDevice) && usbd_enable(UART_usbDevice)) {
		LOG_ERR("Failed to enable device support");
		return 1;
    }

    return 0;
}

void UART_InteruptHandler(const struct device * dev, void * user_data) {
	while (uart_irq_update(UART_DEVICE) && uart_irq_is_pending(UART_DEVICE)) {
        if (UART_commandReady == 0 && uart_irq_rx_ready(UART_DEVICE)) {
            char c;
            uart_fifo_read(UART_DEVICE, &c, 1);

            if (c == '\r') {
                UART_commandBuffer[UART_commandBufferIndex] = '\0';
                UART_Write("\r\n", 2);
                UART_DisableInput();
            } else {
                UART_commandBuffer[UART_commandBufferIndex++] = c;
                UART_Write(&c, 1);
            }
		}

		if (uart_irq_tx_ready(dev)) {		
			char buffer[UART_BUFFER_SIZE];

			// Read the data from the ringbuffer
            size_t sendCharacterCount = ring_buf_get(&UART_buffer, buffer, UART_BUFFER_SIZE);

            // If there is nothing in the ringbuffer disable output
            if (sendCharacterCount == 0) {
                uart_irq_tx_disable(dev);
            }

            uart_fifo_fill(dev, buffer, sendCharacterCount);
        }
	}
}

void UART_EnableInput() {
    UART_commandReady = 0;
    UART_commandBufferIndex = 0;
    uart_irq_rx_enable(UART_DEVICE);
}

void UART_DisableInput() {
    UART_commandReady = 1;
    uart_irq_rx_disable(UART_DEVICE);
}

void UART_Write(char * string, size_t length) {
    ring_buf_put(&UART_buffer, string, length);
    uart_irq_tx_enable(UART_DEVICE);
}
```
